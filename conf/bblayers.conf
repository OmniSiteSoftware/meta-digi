## conf/bblayers.conf
```bitbake
# POKY_BBLAYERS_CONF_VERSION is increased each time build/conf/bblayers.conf
# changes incompatibly
POKY_BBLAYERS_CONF_VERSION = "2"

BBPATH = "${TOPDIR}"
BBFILES ?= ""

BBLAYERS ?= " \
  /home/digi/digi_yocto/wings-yocto/sources/poky/meta \
  /home/digi/digi_yocto/wings-yocto/sources/poky/meta-poky \
  /home/digi/digi_yocto/wings-yocto/sources/poky/meta-yocto-bsp \
  /home/digi/digi_yocto/wings-yocto/sources/meta-openembedded/meta-oe \
  /home/digi/digi_yocto/wings-yocto/sources/meta-openembedded/meta-python \
  /home/digi/digi_yocto/wings-yocto/sources/meta-openembedded/meta-networking \
  /home/digi/digi_yocto/wings-yocto/sources/meta-openembedded/meta-webserver \
  /home/digi/digi_yocto/wings-yocto/sources/meta-qt5 \
  /home/digi/digi_yocto/wings-yocto/sources/meta-swupdate \
  /home/digi/digi_yocto/wings-yocto/sources/meta-webkit \
  /home/digi/digi_yocto/wings-yocto/sources/meta-timesys \
  /home/digi/digi_yocto/wings-yocto/sources/meta-st-stm32mp \
  /home/digi/digi_yocto/wings-yocto/sources/meta-st-stm32mpu-ai \
  /home/digi/digi_yocto/wings-yocto/sources/meta-digi/meta-digi-arm \
  /home/digi/digi_yocto/wings-yocto/sources/meta-digi/meta-digi-dey \
  "
```
